/*
Tests setting different text spacing, bold, thin, wide and tall attributes.
*/

#include <stdint.h>
#include <TFTv2.h>
#include <SeeedTouchScreen.h>
#include <SPI.h>
#define FONT_SPACE 6
#define FONT_X 8
#define FONT_Y 8

TouchScreen ts = TouchScreen(XP, YP, XM, YM); //init TouchScreen port pins

const unsigned char oldsimpleFont[][8] PROGMEM =
{
  {0x00, 0x00, 0x00, 0x00, 0x00, 0x00, 0x00, 0x00},
  {0x00, 0x00, 0x5F, 0x00, 0x00, 0x00, 0x00, 0x00},
  {0x00, 0x00, 0x07, 0x00, 0x07, 0x00, 0x00, 0x00},
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  {0x00, 0x02, 0x05, 0x05, 0x02, 0x00, 0x00, 0x00}
};


void oldChar( INT8U ascii, INT16U poX, INT16U poY, INT16U size, INT16U fgcolor)
{
  if ((ascii >= 32) && (ascii <= 127))
  {
    ;
  }
  else
  {
    ascii = '?' - 32;
  }
  for (int i = 0; i < FONT_X; i++ ) {
    INT8U temp = pgm_read_byte(&oldsimpleFont[ascii - 0x20][i]);
    for (INT8U f = 0; f < 8; f++)
    {
      if ((temp >> f) & 0x01)
      {
        Tft.fillRectangle(poX + i * size, poY + f * size, size, size, fgcolor);
      }

    }

  }
}

void oldString(char *string, INT16U poX, INT16U poY, INT16U size, INT16U fgcolor)
{
  while (*string)
  {
    oldChar(*string, poX, poY, size, fgcolor);
    *string++;

    if (poX < MAX_X)
    {
      poX += FONT_SPACE * size;		/* Move cursor right            */ // +size ASC
    }
  }
}


void setup()
{
  TFT_BL_ON;      // turn on the background light
  Tft.TFTinit();  // init TFT library

  Tft.drawString("new default: abcdefghijABCDEFGHIJ", 0, 0, 1, WHITE);

  oldString("old default: abcdefghijABCDEFGHIJ", 0, 10, 1, WHITE);

  Tft.setThin();
  Tft.drawString("spaced thin: abcdefghijABCDEFGHIJ", 0, 20, 1, WHITE);
  Tft.setTall();
  Tft.drawString("spaced tall: abcdefghijABCDEFGHIJ", 0, 30, 1, WHITE);
  Tft.setWide();
  Tft.drawString("spaced wide: abcdefghijABCDEFGHIJ", 0, 40, 1, WHITE);
  Tft.setBold();
  Tft.drawString("spaced bold: abcdefghijABCDEFGHIJ", 0, 50, 1, WHITE);

  Tft.setSpacing(2);
  Tft.drawString("wider:       abcdefghijABCDEFGHIJ", 0, 60, 1, WHITE);
  Tft.setSpacing(1);
  Tft.drawString("new default: abcdefghijABCDEFGHIJ", 0, 70, 1, WHITE);

  Tft.drawNumber(1234567890, 0, 80, 1, WHITE);
  Tft.drawFloat(1.234567890, 0, 90, 1, WHITE);
  Tft.drawFloat(1.234567890, 5, 0, 100, 1, WHITE);
  Tft.drawFloat(-1.234567890, 0, 110, 1, WHITE);
  Tft.drawFloat(-1.234567890, 5, 0, 120, 1, WHITE);

  delay(15000);
  Tft.fillScreen();

  Tft.setThin();

}

void loop()
{
  Point p;

  int size = 1;
  char buff[26];

  for (int s = 1; s < 6; s++)
  {
    int c = 32;

    for (int i = 0; i < 20; i++)
    {
      int b = 0;
      int x = 0;
      do
      {
        buff[b++] = c++;
        if (c == 127)
        {
          c = 32;
        }
        x += 6 * s;
      } while (x < 200);

      buff[b] = 0;

      Tft.drawString(buff, 0, i * s * 8, s, WHITE);
    }

    do
    {
      // a point object holds x y and z coordinates.
      p = ts.getPoint();

      //map the ADC value read to into pixel co-ordinates
      p.x = map(p.x, TS_MINX, TS_MAXX, 0, 240);
      p.y = map(p.y, TS_MINY, TS_MAXY, 0, 320);
    }
    // we have some minimum pressure we consider 'valid'
    // pressure of 0 means no pressing!
    while (p.z < __PRESURE);

    delay(1000);
    Tft.fillScreen();
  }

  Tft.setBold();
}
